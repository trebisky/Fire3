## U-Boot/arch/arm/mach-nexell/Kconfig
```kconfig
if ARCH_NEXELL

config NEXELL_COMMON
	bool "Nexell common options"

config NEXELL_ARMV7_COMMON
	bool "Nexell 32-bit common options"
	select CPU_V7
	select NEXELL_COMMON

config NEXELL_ARMV8_COMMON
	bool "Nexell 64-bit common options"
	select ARM64
	select ARMV8_MULTIENTRY
	select NEXELL_COMMON

choice
	prompt "Nexell SoC select"
	optional

config ARCH_S5P4418
	bool "Nexell S5P4418 family"
	select NEXELL_ARMV7_COMMON

config ARCH_S5P6818
	bool "Nexell S5P6818 family"
	select NEXELL_ARMV8_COMMON
endchoice

if ARCH_S5P4418
menu "Board for S5P4418"
source "board/nexell/s5p4418/Kconfig"
endmenu
endif

if ARCH_S5P6818
menu "Board for S5P6818"
source "board/nexell/s5p6818/Kconfig"
endmenu
endif

config SYS_SOC
	default "nexell"

endif
```

## U-Boot/board/nexell/common/Kconfig
```kconfig
config ARTIK_OTA
	bool "ARTIK Update feature"
	help
	  This feature provides OTA(Over-The-Air) function.
	  It updates kernel & modules partition without
	  the need of physical access.
```

## U-Boot/board/nexell/s5p4418/Kconfig
```kconfig
choice
	prompt "Board select"

config TARGET_S5P4418_DRONE
	bool "S5P4418_DRONE"
	help
	  Support for s5p4418 drone platform.

config TARGET_ARTIK530_RAPTOR
        bool "ARTIK530_RAPTOR"
	help
	  Support for artik530_raptor platform.

config TARGET_ARTIK305_RAPTOR
        bool "ARTIK305_RAPTOR"
	help
	  Support for artik305_raptor platform.

endchoice

config SYS_VENDOR
	default "nexell"

config SYS_BOARD
	default "s5p4418"

config SYS_CONFIG_NAME
	string "Board header file"
	help
	  This option should contain the base name of board header file.
	  The header file include/configs/<CONFIG_SYS_CONFIG_NAME>.h
	  should be included from include/config.h.

source "board/nexell/common/Kconfig"
```

## U-Boot/board/nexell/s5p6818/Kconfig
```kconfig
choice
	prompt "Board select"

config TARGET_S5P6818_DRONE
	bool "S5P6818_DRONE"
	help
	  Support for s5p6818 drone platform.

config TARGET_ARTIK710_RAPTOR
	bool "ARTIK710_RAPTOR"
	help
	  Support for artik710_raptor platform.

endchoice

config SYS_VENDOR
	default "nexell"

config SYS_BOARD
	default "s5p6818"

config SYS_CONFIG_NAME
	string "Board header file"
	help
	  This option should contain the base name of board header file.
	  The header file include/configs/<CONFIG_SYS_CONFIG_NAME>.h
	  should be included from include/config.h.

source "board/nexell/common/Kconfig"
```

## U-Boot/configs/artik530_raptor_defconfig
```kconfig
CONFIG_ARM=y
CONFIG_SYS_CONFIG_NAME="artik530_raptor"
CONFIG_ARCH_NEXELL=y
CONFIG_ARCH_S5P4418=y
CONFIG_TARGET_ARTIK530_RAPTOR=y
CONFIG_ARTIK_OTA=y
CONFIG_DM_I2C=y
CONFIG_DM_GPIO=y
CONFIG_DEFAULT_DEVICE_TREE="s5p4418-artik530-raptor"
# CONFIG_SYS_MALLOC_CLEAR_ON_INIT is not set
CONFIG_FIT=y
# CONFIG_CMD_IMI is not set
# CONFIG_CMD_IMLS is not set
# CONFIG_CMD_FLASH is not set
CONFIG_CMD_I2C=y
CONFIG_CMD_USB=y
# CONFIG_CMD_FPGA is not set
CONFIG_CMD_GPIO=y
# CONFIG_CMD_NFS is not set
CONFIG_CMD_PING=y
CONFIG_CMD_FDISK=y
CONFIG_CMD_EXT4_IMG_WRITE=y
CONFIG_CMD_SD_RECOVERY=y
CONFIG_CMD_PMIC=y
CONFIG_CMD_REGULATOR=y
CONFIG_OF_CONTROL=y
CONFIG_OF_EMBED=y
CONFIG_NET_RANDOM_ETHADDR=y
CONFIG_DM=y
CONFIG_NX_GPIO=y
CONFIG_DM_I2C_GPIO=y
CONFIG_SENSORID=y
CONFIG_SENSORID_ARTIK=y
CONFIG_DM_ETH=y
CONFIG_ETH_DESIGNWARE=y
CONFIG_PINCTRL=y
CONFIG_DM_PMIC=y
CONFIG_DM_PMIC_NXE2000=y
CONFIG_DM_REGULATOR=y
CONFIG_DM_REGULATOR_NXE2000=y
CONFIG_USB=y
CONFIG_DM_USB=y
CONFIG_USB_EHCI_HCD=y
CONFIG_USB_STORAGE=y
CONFIG_ERRNO_STR=y
```

## U-Boot/configs/artik710_raptor_legacy_defconfig
```kconfig
CONFIG_ARM=y
CONFIG_SYS_CONFIG_NAME="artik710_raptor"
CONFIG_ARCH_NEXELL=y
CONFIG_ARCH_S5P6818=y
CONFIG_TARGET_ARTIK710_RAPTOR=y
# CONFIG_SYS_MALLOC_F is not set
CONFIG_DM_I2C=y
CONFIG_DM_GPIO=y
CONFIG_DEFAULT_DEVICE_TREE="s5p6818-artik710-raptor"
# CONFIG_SYS_MALLOC_CLEAR_ON_INIT is not set
CONFIG_FIT=y
# CONFIG_CMD_IMI is not set
# CONFIG_CMD_IMLS is not set
# CONFIG_CMD_FLASH is not set
CONFIG_CMD_USB=y
# CONFIG_CMD_FPGA is not set
CONFIG_CMD_GPIO=y
# CONFIG_CMD_NFS is not set
CONFIG_CMD_PING=y
CONFIG_CMD_FDISK=y
CONFIG_CMD_EXT4_IMG_WRITE=y
CONFIG_CMD_SD_RECOVERY=y
CONFIG_CMD_PMIC=y
CONFIG_CMD_REGULATOR=y
CONFIG_OF_CONTROL=y
CONFIG_OF_EMBED=y
CONFIG_NET_RANDOM_ETHADDR=y
CONFIG_DM=y
CONFIG_NX_GPIO=y
CONFIG_DM_I2C_GPIO=y
CONFIG_SYS_I2C_NEXELL=y
CONFIG_SENSORID=y
CONFIG_SENSORID_ARTIK=y
CONFIG_DM_ETH=y
CONFIG_ETH_DESIGNWARE=y
CONFIG_PINCTRL=y
CONFIG_DM_PMIC=y
CONFIG_DM_PMIC_NXE2000=y
CONFIG_DM_REGULATOR=y
CONFIG_DM_REGULATOR_NXE2000=y
CONFIG_USB=y
CONFIG_DM_USB=y
CONFIG_USB_EHCI_HCD=y
CONFIG_USB_STORAGE=y
CONFIG_ERRNO_STR=y
```

## U-Boot/configs/s5p4418_drone_defconfig
```kconfig
CONFIG_ARM=y
CONFIG_SYS_CONFIG_NAME="s5p4418_drone"
CONFIG_ARCH_NEXELL=y
CONFIG_ARCH_S5P4418=y
CONFIG_DM_I2C=y
CONFIG_DM_GPIO=y
CONFIG_DEFAULT_DEVICE_TREE="s5p4418-drone"
CONFIG_FIT=y
# CONFIG_CMD_IMI is not set
# CONFIG_CMD_IMLS is not set
# CONFIG_CMD_FLASH is not set
CONFIG_CMD_I2C=y
CONFIG_CMD_USB=y
# CONFIG_CMD_FPGA is not set
CONFIG_CMD_GPIO=y
# CONFIG_CMD_SETEXPR is not set
# CONFIG_CMD_NET is not set
# CONFIG_CMD_NFS is not set
CONFIG_CMD_FDISK=y
CONFIG_CMD_EXT4_IMG_WRITE=y
CONFIG_OF_CONTROL=y
CONFIG_OF_EMBED=y
CONFIG_DM=y
CONFIG_NX_GPIO=y
CONFIG_DM_I2C_GPIO=y
CONFIG_SYS_I2C_NEXELL=y
CONFIG_DM_PWM=y
CONFIG_USB=y
CONFIG_DM_USB=y
CONFIG_USB_EHCI_HCD=y
CONFIG_USB_STORAGE=y
```

## U-Boot/configs/s5p6818_drone_defconfig
```kconfig
CONFIG_ARM=y
CONFIG_SYS_CONFIG_NAME="s5p6818_drone"
CONFIG_ARCH_NEXELL=y
CONFIG_ARCH_S5P6818=y
CONFIG_SYS_MALLOC_F=y
CONFIG_DEFAULT_DEVICE_TREE="s5p6818-drone"
CONFIG_FIT=y
# CONFIG_CMD_IMI is not set
# CONFIG_CMD_IMLS is not set
# CONFIG_CMD_FLASH is not set
# CONFIG_CMD_FPGA is not set
# CONFIG_CMD_SETEXPR is not set
# CONFIG_CMD_NET is not set
# CONFIG_CMD_NFS is not set
CONFIG_CMD_FDISK=y
CONFIG_CMD_EXT4_IMG_WRITE=y
CONFIG_CMD_SD_RECOVERY=y
CONFIG_OF_CONTROL=y
CONFIG_OF_EMBED=y
```

## U-Boot/drivers/pinctrl/nexell/Kconfig
```kconfig
if ARCH_NEXELL

config PINCTRL_NEXELL
	bool "Nexell pinctrl driver"

config PINCTRL_NEXELL_S5PXX18
	bool "Nexell s5pxx18 SoC pinctrl driver"
	default y
	depends on ARCH_NEXELL && PINCTRL_FULL
	select PINCTRL_NEXELL

endif
```
