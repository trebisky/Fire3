/*
 * (C) Copyright 2017 Samsung Electronics.
 * Jaewon Kim <jaewon02.kim@samsung.com>
 *
 * SPDX-License-Identifier:      GPL-2.0+
 */

/dts-v1/;
#include "s5p4418-artik530-raptor-common.dtsi"

/ {
	model = "Samsung artik533 raptor board based on Nexell s5p4418";
};
